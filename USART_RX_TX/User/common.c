
#include "common.h"
#include "./usart/bsp_debug_usart.h"
int i = 0;
const unsigned char crc8Table[256] = {
    0x00, 0x07, 0x0E, 0x09, 0x1C, 0x1B, 0x12, 0x15,
    0x38, 0x3F, 0x36, 0x31, 0x24, 0x23, 0x2A, 0x2D,
    0x70, 0x77, 0x7E, 0x79, 0x6C, 0x6B, 0x62, 0x65,
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    0xE6, 0xE1, 0xE8, 0xEF, 0xFA, 0xFD, 0xF4, 0xF3
};

int byteArrayToInt(char* byteArray) {
    int result = 0;
    result |= byteArray[3] << 24;
    result |= byteArray[2] << 16;
    result |= byteArray[1] << 8;
    result |= byteArray[0];
    return result;
}

void intToByteArray(int number, char* byteArray) {
    byteArray[0] = number & 0xFF;
    byteArray[1] = (number >> 8) & 0xFF;
    byteArray[2] = (number >> 16) & 0xFF;
    byteArray[3] = (number >> 24) & 0xFF;
}

//unsigned char calculateCRC8(const unsigned int* data, int length) 
//{
//    unsigned char crc = 0;
//    for( i = 0; i < length; ++i) {
//        crc = crc8Table[crc ^ data[i]];
//        printf("value:%0x ",data[i]);
//    }
//    return crc;
//}

unsigned char calculateCRC8(const unsigned char* data, int length) 
{
    unsigned char crc = 0;
    for( i = 0; i < length; ++i) {
        crc = crc8Table[crc ^ data[i]];
        printf("value:%0x ",data[i]);
    }
    return crc;
}

void copy_struct_to_array(unsigned char* rebuff, void* structure, int struct_size) 
{
    unsigned char* struct_ptr = structure;
    int length = 0;

    
    for(i = 0; i < struct_size; i++) 
    {
        length = sizeof(*struct_ptr);
        if(length == 2){
            rebuff[i] = ((*struct_ptr)>>8);
            rebuff[i+1] = *struct_ptr;
        }
        else if(length == 4)
        {
            rebuff[i] = ((*struct_ptr)>>24);
            rebuff[i+1] = (*struct_ptr>>16)&0x00ff;
            rebuff[i+2] = (*struct_ptr>>8)&0x0000ff;
            rebuff[i+3] = (*struct_ptr)&0x000000ff;
        }else
        rebuff[i] = *struct_ptr;
        struct_ptr++;
    }
}

void memcpy_big_endian(void* dest, const void* src, int n) {
    const unsigned char* src_ptr = (const unsigned char*)src;
    unsigned char* dest_ptr = (unsigned char*)dest;
    
    for ( i = 0; i < n; i++) {
        dest_ptr[i] = src_ptr[n - 1 - i];
    }
}

unsigned char lsb_checksum(const unsigned char* data, int length) 
{
    unsigned int sum = 0;

    for (i = 0; i < length; i++) {
        sum += data[i];
    }

    return (unsigned char)(sum & 0xFF);
}

